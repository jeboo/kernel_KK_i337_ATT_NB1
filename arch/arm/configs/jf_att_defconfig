## arch/arm/configs/jf_att_defconfig
```kconfig
CONFIG_MACH_JF_ATT=y
CONFIG_EXTRA_FIRMWARE="audience-es325-fw.bin"
CONFIG_EXTRA_FIRMWARE_DIR="firmware"
CONFIG_IRDA_MC96=y
# InsideSecure VPN Client
CONFIG_INSIDESECURE_VPNCLIENT=y
CONFIG_LOCALVERSION_AUTO=n
CONFIG_LOCALVERSION="-Jeboo_Kernel_v3.0a"
```
